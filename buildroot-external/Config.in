## buildroot-external/Config.in
```kconfig
source "$BR2_EXTERNAL_F1C200S_PATH/package/esp-hosted-linux/Config.in"
source "$BR2_EXTERNAL_F1C200S_PATH/package/gateway-control/Config.in"
```

## buildroot-external/configs/f1c200s_gateway_defconfig
```kconfig
BR2_arm=y
BR2_arm926t=y
BR2_ARM_EABI=y
BR2_ARM_SOFT_FLOAT=y
BR2_TOOLCHAIN_EXTERNAL=y
BR2_TOOLCHAIN_EXTERNAL_BOOTLIN=y
BR2_TOOLCHAIN_EXTERNAL_BOOTLIN_ARMV5_EABI_MUSL_STABLE=y
BR2_DL_DIR="$(BR2_EXTERNAL_F1C200S_PATH)/../dl"
BR2_JLEVEL=4
BR2_TARGET_GENERIC_HOSTNAME="f1c200s-gateway"
BR2_TARGET_GENERIC_ISSUE="F1C200S ESP32-C3 Debug Gateway - first board development"
BR2_TARGET_ENABLE_ROOT_LOGIN=y
BR2_TARGET_GENERIC_ROOT_PASSWD=""
BR2_TARGET_GENERIC_GETTY_PORT="ttyS0"
BR2_TARGET_GENERIC_GETTY_BAUDRATE_115200=y
BR2_ROOTFS_DEVICE_CREATION_DYNAMIC_MDEV=y
BR2_ROOTFS_OVERLAY="$(BR2_EXTERNAL_F1C200S_PATH)/board/gateway/rootfs-overlay"
BR2_ROOTFS_POST_BUILD_SCRIPT="$(BR2_EXTERNAL_F1C200S_PATH)/board/gateway/post-build.sh"
BR2_ROOTFS_POST_IMAGE_SCRIPT="$(BR2_EXTERNAL_F1C200S_PATH)/board/gateway/post-image.sh"
BR2_PACKAGE_BUSYBOX_CONFIG_FRAGMENT_FILES="$(BR2_EXTERNAL_F1C200S_PATH)/board/gateway/busybox.fragment"
BR2_LINUX_KERNEL=y
BR2_LINUX_KERNEL_LATEST_VERSION=y
BR2_LINUX_KERNEL_USE_CUSTOM_CONFIG=y
BR2_LINUX_KERNEL_CUSTOM_CONFIG_FILE="$(BR2_EXTERNAL_F1C200S_PATH)/board/gateway/linux.config"
BR2_LINUX_KERNEL_ZIMAGE=y
BR2_LINUX_KERNEL_DTS_SUPPORT=y
BR2_LINUX_KERNEL_CUSTOM_DTS_DIR="$(BR2_EXTERNAL_F1C200S_PATH)/board/gateway/dts"
BR2_LINUX_KERNEL_NEEDS_HOST_OPENSSL=y
BR2_PACKAGE_ESP_HOSTED_LINUX=y
BR2_PACKAGE_MDNSD=y
BR2_PACKAGE_MDNSD_HTTP_SERVICE=y
BR2_PACKAGE_CJSON=y
BR2_PACKAGE_DROPBEAR=y
BR2_PACKAGE_DROPBEAR_SMALL=y
BR2_PACKAGE_OPENOCD=y
BR2_PACKAGE_OPENOCD_STLINK=y
BR2_PACKAGE_LIBUSB=y
BR2_PACKAGE_WPA_SUPPLICANT=y
BR2_PACKAGE_WPA_SUPPLICANT_NL80211=y
BR2_PACKAGE_WPA_SUPPLICANT_CLI=y
BR2_PACKAGE_WIRELESS_REGDB=y
BR2_PACKAGE_IW=y
BR2_PACKAGE_IPROUTE2=y
BR2_PACKAGE_LIBGPIOD=y
BR2_PACKAGE_LIBGPIOD_TOOLS=y
BR2_PACKAGE_GATEWAY_CONTROL=y
BR2_PACKAGE_USBUTILS=y
BR2_PACKAGE_MTD=y
BR2_PACKAGE_MTD_FLASH_ERASE=y
BR2_PACKAGE_MTD_NANDWRITE=y
BR2_PACKAGE_MTD_NANDDUMP=y
BR2_PACKAGE_MTD_UBIATTACH=y
BR2_PACKAGE_MTD_UBIDETACH=y
BR2_PACKAGE_MTD_UBIFORMAT=y
BR2_PACKAGE_MTD_UBIMKVOL=y
BR2_PACKAGE_MTD_UBINFO=y
BR2_PACKAGE_MTD_UBIUPDATEVOL=y
BR2_TARGET_ROOTFS_CPIO=y
BR2_TARGET_ROOTFS_CPIO_GZIP=y
BR2_TARGET_ROOTFS_TAR=y
BR2_TARGET_ROOTFS_TAR_GZIP=y
BR2_TARGET_UBOOT=y
BR2_TARGET_UBOOT_BUILD_SYSTEM_KCONFIG=y
BR2_TARGET_UBOOT_LATEST_VERSION=y
BR2_TARGET_UBOOT_BOARD_DEFCONFIG="licheepi_nano"
BR2_TARGET_UBOOT_PATCH="$(BR2_EXTERNAL_F1C200S_PATH)/board/gateway/patches/uboot"
BR2_TARGET_UBOOT_CONFIG_FRAGMENT_FILES="$(BR2_EXTERNAL_F1C200S_PATH)/board/gateway/uboot.fragment"
BR2_TARGET_UBOOT_CUSTOM_DTS_PATH="$(BR2_EXTERNAL_F1C200S_PATH)/board/gateway/uboot-gateway.dts $(BR2_EXTERNAL_F1C200S_PATH)/board/gateway/dts/allwinner/gateway-nand-partitions.dtsi"
BR2_TARGET_UBOOT_DEFAULT_ENV_FILE="$(BR2_EXTERNAL_F1C200S_PATH)/board/gateway/uboot-default.env"
BR2_TARGET_UBOOT_NEEDS_DTC=y
BR2_TARGET_UBOOT_NEEDS_PYLIBFDT=y
BR2_TARGET_UBOOT_NEEDS_OPENSSL=y
BR2_TARGET_UBOOT_SPL=y
BR2_TARGET_UBOOT_SPL_NAME="u-boot-sunxi-with-spl.bin"
# BR2_TARGET_UBOOT_FORMAT_BIN is not set
BR2_PACKAGE_HOST_UBOOT_TOOLS=y
BR2_PACKAGE_HOST_SUNXI_TOOLS=y
BR2_PACKAGE_HOST_UBOOT_TOOLS_FIT_SUPPORT=y
BR2_TARGET_ROOTFS_UBIFS=y
BR2_TARGET_ROOTFS_UBIFS_LEBSIZE=0x1f000
BR2_TARGET_ROOTFS_UBIFS_MINIOSIZE=0x800
BR2_TARGET_ROOTFS_UBIFS_MAXLEBCNT=928
BR2_TARGET_ROOTFS_UBI=y
BR2_TARGET_ROOTFS_UBI_PEBSIZE=0x20000
BR2_TARGET_ROOTFS_UBI_SUBSIZE=2048
```

## buildroot-external/package/esp-hosted-linux/Config.in
```kconfig
config BR2_PACKAGE_ESP_HOSTED_LINUX
	bool "ESP-Hosted Linux SPI kernel module"
	depends on BR2_LINUX_KERNEL
	help
	  Build the pinned Espressif Linux SPI host driver for ESP32-C3.
	  Matching ESP firmware and the board-specific device tree are required.
```

## buildroot-external/package/gateway-control/Config.in
```kconfig
config BR2_PACKAGE_GATEWAY_CONTROL
	bool "F407 gateway GPIO control service"
	select BR2_PACKAGE_LIBGPIOD
	depends on BR2_TOOLCHAIN_HEADERS_AT_LEAST_4_8
	help
	  Hold and control PD5 NRST request, PD6 BOOT0 and PE4 target interface.
	  This board uses libgpiod 1.6.x line names; hardware tests are required.
```
